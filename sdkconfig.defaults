## sdkconfig.defaults
```kconfig
# --- Flash / partition table ---
CONFIG_ESPTOOLPY_FLASHSIZE_4MB=y
CONFIG_PARTITION_TABLE_CUSTOM=y
CONFIG_PARTITION_TABLE_CUSTOM_FILENAME="partitions.csv"
CONFIG_PARTITION_TABLE_FILENAME="partitions.csv"

# --- WiFi ---
CONFIG_ESP_WIFI_ENABLED=y
CONFIG_ESP_WIFI_NVS_ENABLED=y

# --- HTTP Server ---
CONFIG_HTTPD_MAX_REQ_HDR_LEN=1024
CONFIG_HTTPD_MAX_URI_LEN=512

# --- SPIFFS ---
CONFIG_SPIFFS_MAX_PARTITIONS=3

# --- mDNS ---
CONFIG_MDNS_ENABLED=y
CONFIG_MDNS_MULTIPLE_INSTANCES=y

# --- FreeRTOS ---
CONFIG_FREERTOS_HZ=1000

# --- LWIP ---
CONFIG_LWIP_MAX_SOCKETS=16

# --- Logging ---
CONFIG_LOG_DEFAULT_LEVEL_INFO=y
```
